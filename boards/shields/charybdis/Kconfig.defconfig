## boards/shields/charybdis/Kconfig.defconfig
```kconfig
###
if SHIELD_CHARYBDIS_DONGLE

config ZMK_KEYBOARD_NAME
	default "CharybdisDongle"
config ZMK_SPLIT_BLE_CENTRAL_PERIPHERALS
    default 2
endif

###
if SHIELD_CHARYBDIS_RIGHT

config ZMK_KEYBOARD_NAME
	default "CharybdisBT"
config ZMK_SPLIT_BLE_CENTRAL_PERIPHERALS
    default 1

endif


###
if SHIELD_CHARYBDIS_DONGLE || SHIELD_CHARYBDIS_RIGHT

config ZMK_SPLIT_ROLE_CENTRAL
    default y
config BT_MAX_CONN
    default 5
config BT_MAX_PAIRED
    default 5

endif

###
if SHIELD_CHARYBDIS_DONGLE || SHIELD_CHARYBDIS_RIGHT || SHIELD_CHARYBDIS_RIGHT_PERIPH

config SPI
    default y
config INPUT
    default y
config ZMK_EXT_POWER
    default y
config ZMK_PM_SOFT_OFF
    default y

endif

###
if SHIELD_CHARYBDIS_LEFT

endif


###
if SHIELD_CHARYBDIS_RIGHT || SHIELD_CHARYBDIS_RIGHT_PERIPH || SHIELD_CHARYBDIS_LEFT

config ZMK_SLEEP
    default y
config ZMK_BATTERY_REPORTING
    default y
    
endif


### All shields
if SHIELD_CHARYBDIS_DONGLE || SHIELD_CHARYBDIS_RIGHT || SHIELD_CHARYBDIS_RIGHT_PERIPH || SHIELD_CHARYBDIS_LEFT

config ZMK_SPLIT
    default y

endif
```

## boards/shields/charybdis/Kconfig.shield
```kconfig
config SHIELD_CHARYBDIS_LEFT
	def_bool $(shields_list_contains,charybdis_left)

config SHIELD_CHARYBDIS_RIGHT
	def_bool $(shields_list_contains,charybdis_right)

config SHIELD_CHARYBDIS_RIGHT_PERIPH
	def_bool $(shields_list_contains,charybdis_right_periph)

config SHIELD_CHARYBDIS_DONGLE
	def_bool $(shields_list_contains,charybdis_dongle)
```

## boards/shields/charybdis4x6/Kconfig.defconfig
```kconfig
config ZMK_SPLIT
    default y

if ZMK_BLE

config ZMK_SPLIT_BLE
    default y

if SHIELD_CHARYBDIS4x6_DONGLE
config ZMK_SPLIT_BLE_CENTRAL_PERIPHERALS
    default 2
endif

if SHIELD_CHARYBDIS4x6_RIGHT
config ZMK_SPLIT_BLE_CENTRAL_PERIPHERALS
    default 1
endif

if SHIELD_CHARYBDIS4x6_LEFT || SHIELD_CHARYBDIS4x6_RIGHT_PERIPH 
config ZMK_SPLIT_ROLE_CENTRAL
    default n
config ZMK_SPLIT_BLE_CENTRAL_BATTERY_LEVEL_PROXY
    default n
config ZMK_USB 
    default n
config ZMK_SPLIT_BLE_CENTRAL_BATTERY_LEVEL_FETCHING
    default y
endif

if SHIELD_CHARYBDIS4x6_DONGLE || SHIELD_CHARYBDIS4x6_RIGHT
config BT_MAX_CONN
    default 5
config BT_MAX_PAIRED
    default 5
endif

if SHIELD_CHARYBDIS4x6_RIGHT || SHIELD_CHARYBDIS4x6_RIGHT_PERIPH || SHIELD_CHARYBDIS4x6_LEFT
config ZMK_SLEEP
    default y
endif

endif
    
if SHIELD_CHARYBDIS4x6_DONGLE
config ZMK_KEYBOARD_NAME
    default "CharybdisDongle"
endif

if SHIELD_CHARYBDIS4x6_RIGHT
config ZMK_KEYBOARD_NAME
    default "Charybdis"
endif

if SHIELD_CHARYBDIS4x6_DONGLE  || SHIELD_CHARYBDIS4x6_RIGHT
config ZMK_SPLIT_ROLE_CENTRAL
    default y
config BT_BAS
    default y
config ZMK_SPLIT_BLE_CENTRAL_BATTERY_LEVEL_PROXY
    default y
endif

if SHIELD_CHARYBDIS4x6_RIGHT || SHIELD_CHARYBDIS4x6_RIGHT_PERIPH
# https://github.com/badjeff/zmk-pmw3610-driver/blob/main/src/pmw3610.c
config PMW3610_ALT
    default y
config PMW3610_ALT_SMART_ALGORITHM
    default y
config PMW3610_ALT_SWAP_XY
    default y
config PMW3610_ALT_INVERT_X
    default y
config PMW3610_ALT_INVERT_Y
    default y
config PMW3610_ALT_REPORT_INTERVAL_MIN
    default 12
config PMW3610_ALT_REST1_SAMPLE_TIME_MS
    default 100
config PMW3610_ALT_REST2_SAMPLE_TIME_MS
    default 200
config PMW3610_ALT_REST3_SAMPLE_TIME_MS
    default 300
config PMW3610_ALT_RUN_DOWNSHIFT_TIME_MS
    default 2000
config PMW3610_ALT_REST1_DOWNSHIFT_TIME_MS
    default 3000
config PMW3610_ALT_REST2_DOWNSHIFT_TIME_MS
    default 30000
endif

if  SHIELD_CHARYBDIS4x6_DONGLE || SHIELD_CHARYBDIS4x6_RIGHT || SHIELD_CHARYBDIS4x6_RIGHT_PERIPH
config SPI
    default y
config INPUT
    default y
config ZMK_POINTING
    default y
config ZMK_EXT_POWER
    default y
endif
```

## boards/shields/charybdis4x6/Kconfig.shield
```kconfig
config SHIELD_CHARYBDIS4x6_LEFT
	def_bool $(shields_list_contains,charybdis4x6_left)

config SHIELD_CHARYBDIS4x6_RIGHT
	def_bool $(shields_list_contains,charybdis4x6_right)

config SHIELD_CHARYBDIS4x6_RIGHT_PERIPH
	def_bool $(shields_list_contains,charybdis4x6_right_periph)

config SHIELD_CHARYBDIS4x6_DONGLE
	def_bool $(shields_list_contains,charybdis4x6_dongle)
```

## boards/shields/charybdis_4x6/Kconfig.shield
```kconfig
config SHIELD_CHARYBDIS_4x6_LEFT
	def_bool $(shields_list_contains,charybdis_left)

config SHIELD_CHARYBDIS_4x6_RIGHT
	def_bool $(shields_list_contains,charybdis_right)

config SHIELD_CHARYBDIS_4x6_RIGHT_PERIPH
	def_bool $(shields_list_contains,charybdis_right_periph)

config SHIELD_CHARYBDIS_4x6_DONGLE
	def_bool $(shields_list_contains,charybdis_dongle)
```

## boards/shields/sofle-chok/Kconfig.shield
```kconfig
config SHIELD_SOFLE-CHOK_LEFT
	def_bool $(shields_list_contains,sofle-chok_left)

config SHIELD_SOFLE-CHOK_LEFT_PERIPH
	def_bool $(shields_list_contains,sofle-chok_left_periph)

config SHIELD_SOFLE-CHOK_RIGHT
	def_bool $(shields_list_contains,sofle-chok_right)

config SHIELD_SOFLE-CHOK_DONGLE
	def_bool $(shields_list_contains,sofle-chok_dongle)
```

## boards/shields/sofle/Kconfig.defconfig
```kconfig
# Copyright (c) 2020 Ryan Cross
# SPDX-License-Identifier: MIT
config UNDERGLOW
    bool
    default n
config ENCODERS
    bool
    default n

#####################################
#####################################

if SHIELD_SOFLE_LEFT
#-----------------------------------------
config ZMK_KEYBOARD_NAME
    default "Sofle"
#-----------------------------------------
endif # SHIELD_SOFLE_LEFT

#####################################
#####################################

if SHIELD_SOFLE_DONGLE
#-----------------------------------------
config ZMK_KEYBOARD_NAME
    default "SofleDongle"
#-----------------------------------------
endif # SHIELD_SOFLE_LEFT

#####################################
#####################################

if SHIELD_SOFLE_LEFT || SHIELD_SOFLE_DONGLE
#-----------------------------------------
config ZMK_SPLIT_ROLE_CENTRAL
    default y
#-----------------------------------------
endif

#####################################
#####################################

if SHIELD_SOFLE_LEFT || SHIELD_SOFLE_LEFT_PERIPH || SHIELD_SOFLE_DONGLE || SHIELD_SOFLE_RIGHT
#-----------------------------------------
config ZMK_SPLIT
    default y
#-----------------------------------------
endif

if SHIELD_SOFLE_LEFT || SHIELD_SOFLE_LEFT_PERIPH || SHIELD_SOFLE_RIGHT
#-----------------------------------------
if ZMK_DISPLAY
config I2C
    default y
config SSD1306
    default y
endif # ZMK_DISPLAY
#-----------------------------------------
if LVGL
config LV_Z_VDB_SIZE
    default 64
config LV_DPI_DEF
    default 148
config LV_Z_BITS_PER_PIXEL
    default 1
choice LV_COLOR_DEPTH
    default LV_COLOR_DEPTH_1
endchoice
endif # LVGL
#-----------------------------------------
if UNDERGLOW
config ZMK_RGB_UNDERGLOW
    default y
endif # UNDERGLOW
#-----------------------------------------
if ENCODER
config EC11_TRIGGER_GLOBAL_THREAD
    default y
config CONFIG_EC11
    default y
endif # ENCODER
#-----------------------------------------
endif
```

## boards/shields/sofle_chok/Kconfig.shield
```kconfig
config SHIELD_SOFLE_CHOK_LEFT
	def_bool $(shields_list_contains,sofle_chok_left)

config SHIELD_SOFLE_CHOK_LEFT_PERIPH
	def_bool $(shields_list_contains,sofle_chok_left_periph)

config SHIELD_SOFLE_CHOK_RIGHT
	def_bool $(shields_list_contains,sofle_chok_right)

config SHIELD_SOFLE_CHOK_DONGLE
	def_bool $(shields_list_contains,sofle_chok_dongle)
```

## config/west.yml
```yaml
manifest:
  remotes:
    - name: zmkfirmware
      url-base: https://github.com/zmkfirmware
    - name: badjeff
      url-base: https://github.com/badjeff
    - name: dakhar
      url-base: https://github.com/dakhar
  projects:
    - name: zmk
      remote: zmkfirmware
      revision: main
      import: app/west.yml
    - name: zmk-pmw3610-driver
      remote: badjeff
      revision: main
    - name: zmk-dongle-screen-sh1107
      remote: dakhar
      revision: main
  self:
    path: config
```
